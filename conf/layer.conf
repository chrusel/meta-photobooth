## conf/layer.conf
```bitbake
# We have a conf and classes directory, add to BBPATH
BBPATH .= ":${LAYERDIR}"

# We have recipes-* directories, add to BBFILES
BBFILES += "${LAYERDIR}/recipes-*/*/*.bb \
            ${LAYERDIR}/recipes-*/*/*.bbappend"

BBFILE_COLLECTIONS += "meta-photobooth"
BBFILE_PATTERN_meta-photobooth = "^${LAYERDIR}/"
BBFILE_PRIORITY_meta-photobooth = "6"

LAYERDEPENDS_meta-photobooth = "core"
LAYERSERIES_COMPAT_meta-photobooth = "dunfell"
```
